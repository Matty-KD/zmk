## app/boards/arm/SMK/Kconfig.board
```kconfig
config BOARD_SMK_LEFT
	bool "SMK left"
	depends on SOC_NRF52840_QIAA

config BOARD_SMK_RIGHT
	bool "SMK right"
	depends on SOC_NRF52840_QIAA
```

## app/boards/arm/SMK/Kconfig.defconfig
```kconfig
if BOARD_SMK_LEFT

config ZMK_KEYBOARD_NAME
	default "SMK Left"

endif 

if BOARD_SMK_RIGHT
config ZMK_KEYBOARD_NAME
	default "SMK Right"
config ZMK_SPLIT_ROLE_CENTRAL
	default y

endif 


if BOARD_SMK_LEFT || BOARD_SMK_RIGHT

config BOARD
	default "SMK"

config ZMK_SPLIT
	default y

config BT_CTLR
	default BT

config ZMK_BLE
	default y

config ZMK_USB
	default y

# config SPI
# 	default y

if USB

config USB_NRFX
	default y

config USB_DEVICE_STACK
	default y

endif # USB

endif # BOARD_CORNEISH_ZEN_V2_LEFT || BOARD_CORNEISH_ZEN_V2_RIGHT


config MOUSE_LAYER_INDEX
	int "Index of mouse layer"
	default 0

config SCROLL_LAYER_INDEX
	int "Index of scroll layer"
	default 5

config MOUSE_LAYER_ACTIVE_MS
	int "Amount of milliseconds the mouse layer will be active after using the trackball"
	default 400

config NRFMACRO_POINTDEVICE
  bool "add support for point device"
  default y
  select SPI
```

## app/boards/arm/SMK/SMK_left_defconfig
```kconfig
CONFIG_SOC_SERIES_NRF52X=y
CONFIG_SOC_NRF52840_QIAA=y

CONFIG_BOARD_SMK_LEFT=y
CONFIG_ZMK_SPLIT=y
CONFIG_ZMK_SLEEP=y
CONFIG_ZMK_IDLE_SLEEP_TIMEOUT=3600000
CONFIG_ZMK_BLE=y
CONFIG_ZMK_SPLIT_BLE=y

# Enable MPU
CONFIG_ARM_MPU=y

# enable GPIO
CONFIG_GPIO=y

# Enable SPI
CONFIG_SPI=y
CONFIG_SPI_NRFX=y

# Enable writing to flash
CONFIG_USE_DT_CODE_PARTITION=y
CONFIG_BUILD_OUTPUT_UF2=y
CONFIG_MPU_ALLOW_FLASH_WRITE=y
CONFIG_NVS=y
CONFIG_SETTINGS_NVS=y
CONFIG_FLASH=y
CONFIG_FLASH_PAGE_LAYOUT=y
CONFIG_FLASH_MAP=y

# Enable 32kHz crystal
CONFIG_CLOCK_CONTROL_NRF_K32SRC_XTAL=y
CONFIG_CLOCK_CONTROL_NRF_K32SRC_30PPM=y



# Turn on logging, and set ZMK logging to debug output
CONFIG_LOG=y
CONFIG_ZMK_USB_LOGGING=y
CONFIG_ZMK_LOG_LEVEL_DBG=y
CONFIG_LOG_BUFFER_SIZE=65536
CONFIG_LOG_STRDUP_BUF_COUNT=160


# Turn on USB CDC ACM device
CONFIG_USB_DEVICE_STACK=y
CONFIG_USB_CDC_ACM=y
CONFIG_USB_CDC_ACM_RINGBUF_SIZE=1024

# Enable serial console
CONFIG_SERIAL=y
CONFIG_CONSOLE=y
CONFIG_UART_INTERRUPT_DRIVEN=y
CONFIG_UART_LINE_CTRL=y

# Enable USB UART
CONFIG_UART_CONSOLE=y
```

## app/boards/arm/SMK/SMK_right_defconfig
```kconfig
CONFIG_SOC_SERIES_NRF52X=y
CONFIG_SOC_NRF52840_QIAA=y

CONFIG_BOARD_SMK_RIGHT=y
CONFIG_ZMK_SPLIT=y
CONFIG_ZMK_SPLIT_BLE=y
CONFIG_ZMK_BLE=y


CONFIG_ZMK_SLEEP=y
CONFIG_ZMK_IDLE_SLEEP_TIMEOUT=3600000

# CONFIG_ZMK_SPLIT_ROLE_CENTRAL=y

CONFIG_ZMK_BLE=y

# Enable MPU
CONFIG_ARM_MPU=y

# enable GPIO
CONFIG_GPIO=y
CONFIG_PINCTRL=y

# Enable SPI
CONFIG_SPI=y
CONFIG_SPI_NRFX=y
# CONFIG_SPI_LOG_LEVEL_DBG=y


# Enable writing to flash
CONFIG_USE_DT_CODE_PARTITION=y
CONFIG_BUILD_OUTPUT_UF2=y
CONFIG_MPU_ALLOW_FLASH_WRITE=y
CONFIG_NVS=y
CONFIG_SETTINGS_NVS=y
CONFIG_FLASH=y
CONFIG_FLASH_PAGE_LAYOUT=y
CONFIG_FLASH_MAP=y

# Enable 32kHz crystal
CONFIG_CLOCK_CONTROL_NRF_K32SRC_XTAL=y
CONFIG_CLOCK_CONTROL_NRF_K32SRC_30PPM=y

# Turn on logging, and set ZMK logging to debug output
CONFIG_LOG=y
CONFIG_ZMK_USB_LOGGING=y
CONFIG_ZMK_LOG_LEVEL_DBG=y
CONFIG_LOG_BUFFER_SIZE=65536
CONFIG_LOG_STRDUP_BUF_COUNT=160
CONFIG_PMW3610_LOG_LEVEL_INF=y


# Turn on USB CDC ACM device
CONFIG_USB_DEVICE_STACK=y
CONFIG_USB_CDC_ACM=y
CONFIG_USB_CDC_ACM_RINGBUF_SIZE=1024

# Enable serial console
CONFIG_SERIAL=y
CONFIG_CONSOLE=y
CONFIG_UART_INTERRUPT_DRIVEN=y
CONFIG_UART_LINE_CTRL=y

# Enable USB UART
CONFIG_UART_CONSOLE=y



CONFIG_ZMK_EXT_POWER=y

# CONFIG_ZMK_PD_WORK_QUEUE_DEDICATED=n
CONFIG_ZMK_PD_DEDICATED_WORK_QUEUE_PRIORITY=2
CONFIG_ZMK_TRACKBALL_POLL_DURATION=8

CONFIG_ZMK_MOUSE=y
CONFIG_ZMK_MOUSE_TICK_DURATION=10
CONFIG_ZMK_MOUSE_WORK_QUEUE_DEDICATED=y
CONFIG_ZMK_MOUSE_DEDICATED_THREAD_PRIORITY=1

CONFIG_PMW3610=y
#CONFIG_PMW3610_CPI=1600
#CONFIG_PMW3610_CPI_DIVIDOR=4
CONFIG_PMW3610_ORIENTATION_90=y
CONFIG_PMW3610_INVERT_X=y
CONFIG_PMW3610_REST1_SAMPLE_TIME_MS=100
CONFIG_PMW3610_REST2_SAMPLE_TIME_MS=200
CONFIG_PMW3610_REST3_SAMPLE_TIME_MS=300
CONFIG_PMW3610_RUN_DOWNSHIFT_TIME_MS=500
CONFIG_PMW3610_REST1_DOWNSHIFT_TIME_MS=3000
CONFIG_PMW3610_REST2_DOWNSHIFT_TIME_MS=30000
```
