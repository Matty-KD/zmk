#include "SMK.dtsi"
/{
	kscan0: kscan {
		compatible = "zmk,kscan-gpio-direct";
		label = "KSCAN";
      input-gpios =
       <&gpio0 14 (GPIO_ACTIVE_LOW | GPIO_PULL_UP)>  // Key 5
      , <&gpio0 22 (GPIO_ACTIVE_LOW | GPIO_PULL_UP)>   // key 4
      , <&gpio0 13 (GPIO_ACTIVE_LOW | GPIO_PULL_UP)>  // Key 3
      , <&gpio0 20 (GPIO_ACTIVE_LOW | GPIO_PULL_UP)>  // key 2
      , <&gpio1 5 (GPIO_ACTIVE_LOW | GPIO_PULL_UP)>  // Key 1
      , <&gpio1 12 (GPIO_ACTIVE_LOW | GPIO_PULL_UP)>  // key 11
      , <&gpio0 4 (GPIO_ACTIVE_LOW | GPIO_PULL_UP)>  // Key 10      
      , <&gpio0 27 (GPIO_ACTIVE_LOW | GPIO_PULL_UP)>  // key 9
      , <&gpio0 12 (GPIO_ACTIVE_LOW | GPIO_PULL_UP)>  // key 8
      , <&gpio0 11 (GPIO_ACTIVE_LOW | GPIO_PULL_UP)>  // Key 7
      , <&gpio1 7 (GPIO_ACTIVE_LOW | GPIO_PULL_UP)>  // key 6
      , <&gpio1 11 (GPIO_ACTIVE_LOW | GPIO_PULL_UP)>   // key 16
      , <&gpio0 28 (GPIO_ACTIVE_LOW | GPIO_PULL_UP)>   // key 15
      , <&gpio0 30 (GPIO_ACTIVE_LOW | GPIO_PULL_UP)>   // key 14
      , <&gpio0 5 (GPIO_ACTIVE_LOW | GPIO_PULL_UP)>   // key 13
      , <&gpio1 3 (GPIO_ACTIVE_LOW | GPIO_PULL_UP)>  // key 12
      , <&gpio0 10(GPIO_ACTIVE_LOW | GPIO_PULL_UP)>  // key 23 
      , <&gpio1 10 (GPIO_ACTIVE_LOW | GPIO_PULL_UP)>  // key 22 
      , <&gpio1 2 (GPIO_ACTIVE_LOW | GPIO_PULL_UP)>  // key 21 
      , <&gpio0 3 (GPIO_ACTIVE_LOW | GPIO_PULL_UP)>  // key 20 
      , <&gpio1 13(GPIO_ACTIVE_LOW | GPIO_PULL_UP)>   // key 19 
      , <&gpio1 15 (GPIO_ACTIVE_LOW | GPIO_PULL_UP)>   // key 18 
      , <&gpio1 14 (GPIO_ACTIVE_LOW | GPIO_PULL_UP)>  // key 17 
      ;
   };
};